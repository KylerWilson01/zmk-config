num_pad {
// -----------------------------------------------------------------------------------------
// | BT2 |     |     |     |     |     |      |     |  7  |  8  |  9  |     |     |
// | BT1 | META| LALT| SHFT| CTRL|     |      |     |  4  |  5  |  6  |     |     |
// | BTCL|     | RALT|     |     |     |      |     |  1  |  2  |  3  |     |     |
//                   |     |     |     |      |     |  0  |     |
bindings = <
   &bt BT_SEL 1 &none     &none     &none      &none      &none         &none &kp N7  &kp N8  &kp N9 &none &none
   &bt BT_SEL 0 &kp LMETA &kp LALT  &kp LSHFT  &kp LCTRL  &none         &none &kp N4  &kp N5  &kp N6 &none &none
   &bt BT_CLR   &none     &kp RALT  &none      &none      &none         &none &kp N1  &kp N2  &kp N3 &none &none
                                    &none      &none      &none         &none &kp N0  &none
>;
};
funct {
// -----------------------------------------------------------------------------------------
// |     |     |     |     |     |     |      |     |  F9 | F10 | F11 | F12 |     |
// |     | META| LALT| SHFT| CTRL|     |      |     |  F5 |  F6 |  F7 |  F8 |     |
// |     |     | RALT|     |     |     |      |     |  F1 |  F2 |  F3 |  F4 |     |
//                   |     |     |     |      | PRNT|     |     |
bindings = <
   &none  &none     &none     &none      &none      &none         &none      &kp F7   &kp F8  &kp F9  &kp F12  &none 
   &none  &kp LMETA &kp LALT  &kp LSHFT  &kp LCTRL  &none         &kp CAPS   &kp F4   &kp F5  &kp F6  &kp F11  &none 
   &none  &none     &kp RALT  &none      &none      &none         &none      &kp F1   &kp F2  &kp F3  &kp F10  &none 
                              &trans     &none      &none         &kp PSCRN  &kp RET  &none
>;
};
